/ {
	/delete-node/ lcd;
	/delete-node/ sd_emmc_a;
	/delete-node/ sd_emmc_b2;
	/delete-node/ sd_emmc_b1;
	/delete-node/ sd_emmc_c;
	/delete-node/ wifi;

	spi{
		compatible = "spi-gpio";
		#address-cells = <0x1>;
		ranges;

		gpio-mosi = <&gpio GPIOX_3 GPIO_ACTIVE_HIGH>;
		gpio-miso = <&gpio GPIOX_7 GPIO_ACTIVE_HIGH>;
		gpio-sck = <&gpio GPIOX_4 GPIO_ACTIVE_HIGH>;
		num-chipselects = <0>;
		status = "ok";

		spidev@0{
			compatible = "linux,spidev";
			reg = <0>;
			#address-cells = <1>;
			#size-cells = <0>;
			spi-max-frequency = <32000000>;
			status = "okay";
			bus_num = <1>;
		};
	};
};
